## build/Kconfig/Kconfig.modules
```kconfig
menu "acpica (/home/cyberdeb/zephyrproject/modules/lib/acpica)"
osource "$(ZEPHYR_ACPICA_KCONFIG)"
config ZEPHYR_ACPICA_MODULE
	bool
	default y
endmenu
menu "cmsis-dsp (/home/cyberdeb/zephyrproject/modules/lib/cmsis-dsp)"
osource "$(ZEPHYR_CMSIS_DSP_KCONFIG)"
config ZEPHYR_CMSIS_DSP_MODULE
	bool
	default y
endmenu
menu "cmsis-nn (/home/cyberdeb/zephyrproject/modules/lib/cmsis-nn)"
osource "$(ZEPHYR_CMSIS_NN_KCONFIG)"
config ZEPHYR_CMSIS_NN_MODULE
	bool
	default y
endmenu
menu "fatfs (/home/cyberdeb/zephyrproject/modules/fs/fatfs)"
osource "$(ZEPHYR_FATFS_KCONFIG)"
config ZEPHYR_FATFS_MODULE
	bool
	default y
endmenu
menu "hal_espressif (/home/cyberdeb/zephyrproject/modules/hal/espressif)"
osource "/home/cyberdeb/zephyrproject/modules/hal/espressif/zephyr/Kconfig"
config ZEPHYR_HAL_ESPRESSIF_MODULE
	bool
	default y
	select TAINT_BLOBS

config ZEPHYR_HAL_ESPRESSIF_MODULE_BLOBS
	bool
	default y
endmenu
menu "hal_nordic (/home/cyberdeb/zephyrproject/modules/hal/nordic)"
osource "$(ZEPHYR_HAL_NORDIC_KCONFIG)"
config ZEPHYR_HAL_NORDIC_MODULE
	bool
	default y

config ZEPHYR_HAL_NORDIC_MODULE_BLOBS
	bool
endmenu
config ZEPHYR_XTENSA_MODULE
	bool
	default y
menu "hostap (/home/cyberdeb/zephyrproject/modules/lib/hostap)"
osource "$(ZEPHYR_HOSTAP_KCONFIG)"
config ZEPHYR_HOSTAP_MODULE
	bool
	default y
endmenu
menu "liblc3 (/home/cyberdeb/zephyrproject/modules/lib/liblc3)"
osource "$(ZEPHYR_LIBLC3_KCONFIG)"
config ZEPHYR_LIBLC3_MODULE
	bool
	default y
endmenu
config ZEPHYR_LIBMCTP_MODULE
	bool
	default y
menu "libsbc (/home/cyberdeb/zephyrproject/modules/lib/libsbc)"
osource "$(ZEPHYR_LIBSBC_KCONFIG)"
config ZEPHYR_LIBSBC_MODULE
	bool
	default y
endmenu
menu "littlefs (/home/cyberdeb/zephyrproject/modules/fs/littlefs)"
osource "$(ZEPHYR_LITTLEFS_KCONFIG)"
config ZEPHYR_LITTLEFS_MODULE
	bool
	default y
endmenu
menu "lora-basics-modem (/home/cyberdeb/zephyrproject/modules/lib/lora-basics-modem)"
osource "$(ZEPHYR_LORA_BASICS_MODEM_KCONFIG)"
config ZEPHYR_LORA_BASICS_MODEM_MODULE
	bool
	default y
endmenu
menu "loramac-node (/home/cyberdeb/zephyrproject/modules/lib/loramac-node)"
osource "$(ZEPHYR_LORAMAC_NODE_KCONFIG)"
config ZEPHYR_LORAMAC_NODE_MODULE
	bool
	default y
endmenu
menu "lvgl (/home/cyberdeb/zephyrproject/modules/lib/gui/lvgl)"
osource "/home/cyberdeb/zephyrproject/modules/lib/gui/lvgl/zephyr/Kconfig"
config ZEPHYR_LVGL_MODULE
	bool
	default y
endmenu
menu "mbedtls (/home/cyberdeb/zephyrproject/modules/crypto/mbedtls)"
osource "$(ZEPHYR_MBEDTLS_KCONFIG)"
config ZEPHYR_MBEDTLS_MODULE
	bool
	default y
endmenu
config ZEPHYR_MCUBOOT_MODULE
	bool
	default y
config ZEPHYR_MIPI_SYS_T_MODULE
	bool
	default y
menu "nanopb (/home/cyberdeb/zephyrproject/modules/lib/nanopb)"
osource "$(ZEPHYR_NANOPB_KCONFIG)"
config ZEPHYR_NANOPB_MODULE
	bool
	default y
endmenu
menu "nrf_wifi (/home/cyberdeb/zephyrproject/modules/lib/nrf_wifi)"
osource "$(ZEPHYR_NRF_WIFI_KCONFIG)"
config ZEPHYR_NRF_WIFI_MODULE
	bool
	default y

config ZEPHYR_NRF_WIFI_MODULE_BLOBS
	bool
endmenu
config ZEPHYR_OPEN_AMP_MODULE
	bool
	default y
menu "openthread (/home/cyberdeb/zephyrproject/modules/lib/openthread)"
osource "$(ZEPHYR_OPENTHREAD_KCONFIG)"
config ZEPHYR_OPENTHREAD_MODULE
	bool
	default y
endmenu
menu "percepio (/home/cyberdeb/zephyrproject/modules/debug/percepio)"
osource "/home/cyberdeb/zephyrproject/modules/debug/percepio/zephyr/Kconfig"
config ZEPHYR_PERCEPIO_MODULE
	bool
	default y
endmenu
menu "picolibc (/home/cyberdeb/zephyrproject/modules/lib/picolibc)"
osource "/home/cyberdeb/zephyrproject/modules/lib/picolibc/zephyr/Kconfig"
config ZEPHYR_PICOLIBC_MODULE
	bool
	default y
endmenu
menu "segger (/home/cyberdeb/zephyrproject/modules/debug/segger)"
osource "$(ZEPHYR_SEGGER_KCONFIG)"
config ZEPHYR_SEGGER_MODULE
	bool
	default y
endmenu
menu "trusted-firmware-a (/home/cyberdeb/zephyrproject/modules/tee/tf-a/trusted-firmware-a)"
osource "$(ZEPHYR_TRUSTED_FIRMWARE_A_KCONFIG)"
config ZEPHYR_TRUSTED_FIRMWARE_A_MODULE
	bool
	default y
endmenu
menu "trusted-firmware-m (/home/cyberdeb/zephyrproject/modules/tee/tf-m/trusted-firmware-m)"
osource "$(ZEPHYR_TRUSTED_FIRMWARE_M_KCONFIG)"
config ZEPHYR_TRUSTED_FIRMWARE_M_MODULE
	bool
	default y
endmenu
menu "uoscore-uedhoc (/home/cyberdeb/zephyrproject/modules/lib/uoscore-uedhoc)"
osource "$(ZEPHYR_UOSCORE_UEDHOC_KCONFIG)"
config ZEPHYR_UOSCORE_UEDHOC_MODULE
	bool
	default y
endmenu
menu "zcbor (/home/cyberdeb/zephyrproject/modules/lib/zcbor)"
osource "$(ZEPHYR_ZCBOR_KCONFIG)"
config ZEPHYR_ZCBOR_MODULE
	bool
	default y
endmenu
config ZEPHYR_NRF_HW_MODELS_MODULE
	bool
	default y
```

## build/Kconfig/Kconfig.sysbuild.modules
```kconfig
config ZEPHYR_ACPICA_MODULE
   bool
   default y
config ZEPHYR_CMSIS_DSP_MODULE
   bool
   default y
config ZEPHYR_CMSIS_NN_MODULE
   bool
   default y
config ZEPHYR_FATFS_MODULE
   bool
   default y
config ZEPHYR_HAL_ESPRESSIF_MODULE
   bool
   default y
config ZEPHYR_HAL_NORDIC_MODULE
   bool
   default y
config ZEPHYR_XTENSA_MODULE
   bool
   default y
config ZEPHYR_HOSTAP_MODULE
   bool
   default y
config ZEPHYR_LIBLC3_MODULE
   bool
   default y
config ZEPHYR_LIBMCTP_MODULE
   bool
   default y
config ZEPHYR_LIBSBC_MODULE
   bool
   default y
config ZEPHYR_LITTLEFS_MODULE
   bool
   default y
config ZEPHYR_LORA_BASICS_MODEM_MODULE
   bool
   default y
config ZEPHYR_LORAMAC_NODE_MODULE
   bool
   default y
config ZEPHYR_LVGL_MODULE
   bool
   default y
config ZEPHYR_MBEDTLS_MODULE
   bool
   default y
config ZEPHYR_MCUBOOT_MODULE
   bool
   default y
config ZEPHYR_MIPI_SYS_T_MODULE
   bool
   default y
config ZEPHYR_NANOPB_MODULE
   bool
   default y
config ZEPHYR_NRF_WIFI_MODULE
   bool
   default y
config ZEPHYR_OPEN_AMP_MODULE
   bool
   default y
config ZEPHYR_OPENTHREAD_MODULE
   bool
   default y
config ZEPHYR_PERCEPIO_MODULE
   bool
   default y
config ZEPHYR_PICOLIBC_MODULE
   bool
   default y
config ZEPHYR_SEGGER_MODULE
   bool
   default y
config ZEPHYR_TRUSTED_FIRMWARE_A_MODULE
   bool
   default y
config ZEPHYR_TRUSTED_FIRMWARE_M_MODULE
   bool
   default y
config ZEPHYR_UOSCORE_UEDHOC_MODULE
   bool
   default y
config ZEPHYR_ZCBOR_MODULE
   bool
   default y
config ZEPHYR_NRF_HW_MODELS_MODULE
   bool
   default y
```

## build/Kconfig/arch/Kconfig
```kconfig
# Load Zephyr Arch Kconfig descriptions.
osource "/home/cyberdeb/zephyrproject/zephyr/arch/rx/Kconfig"
osource "/home/cyberdeb/zephyrproject/zephyr/arch/x86/Kconfig"
osource "/home/cyberdeb/zephyrproject/zephyr/arch/xtensa/Kconfig"
osource "/home/cyberdeb/zephyrproject/zephyr/arch/sparc/Kconfig"
osource "/home/cyberdeb/zephyrproject/zephyr/arch/riscv/Kconfig"
osource "/home/cyberdeb/zephyrproject/zephyr/arch/posix/Kconfig"
osource "/home/cyberdeb/zephyrproject/zephyr/arch/mips/Kconfig"
osource "/home/cyberdeb/zephyrproject/zephyr/arch/arm64/Kconfig"
osource "/home/cyberdeb/zephyrproject/zephyr/arch/arm/Kconfig"
osource "/home/cyberdeb/zephyrproject/zephyr/arch/arc/Kconfig"
```

## build/Kconfig/boards/Kconfig
```kconfig
# Load Zephyr board Kconfig descriptions.
osource "/home/cyberdeb/zephyrproject/zephyr/boards/espressif/esp32_devkitc/Kconfig"
```

## build/Kconfig/boards/Kconfig.defconfig
```kconfig
# Load Zephyr board defconfig descriptions.
osource "/home/cyberdeb/zephyrproject/zephyr/boards/espressif/esp32_devkitc/Kconfig.defconfig"
```

## build/Kconfig/boards/Kconfig.esp32_devkitc
```kconfig
# Load board Kconfig descriptions.
osource "/home/cyberdeb/zephyrproject/zephyr/boards/espressif/esp32_devkitc/Kconfig.esp32_devkitc"
```

## build/Kconfig/soc/Kconfig
```kconfig
# Load Zephyr SoC Kconfig descriptions.
osource "/home/cyberdeb/zephyrproject/zephyr/soc/xlnx/zynqmp/Kconfig"
osource "/home/cyberdeb/zephyrproject/zephyr/soc/xlnx/zynq7000/Kconfig"
osource "/home/cyberdeb/zephyrproject/zephyr/soc/xlnx/versalnet/Kconfig"
osource "/home/cyberdeb/zephyrproject/zephyr/soc/xlnx/versal2/Kconfig"
osource "/home/cyberdeb/zephyrproject/zephyr/soc/xen/Kconfig"
osource "/home/cyberdeb/zephyrproject/zephyr/soc/wch/ch32v/Kconfig"
osource "/home/cyberdeb/zephyrproject/zephyr/soc/ti/simplelink/Kconfig"
osource "/home/cyberdeb/zephyrproject/zephyr/soc/ti/mspm0/Kconfig"
osource "/home/cyberdeb/zephyrproject/zephyr/soc/ti/lm3s6965/Kconfig"
osource "/home/cyberdeb/zephyrproject/zephyr/soc/ti/k3/Kconfig"
osource "/home/cyberdeb/zephyrproject/zephyr/soc/telink/tlsr/Kconfig"
osource "/home/cyberdeb/zephyrproject/zephyr/soc/starfive/jh71xx/Kconfig"
osource "/home/cyberdeb/zephyrproject/zephyr/soc/st/stm32/Kconfig"
osource "/home/cyberdeb/zephyrproject/zephyr/soc/snps/qemu_arc/Kconfig"
osource "/home/cyberdeb/zephyrproject/zephyr/soc/snps/nsim/arc_v/Kconfig"
osource "/home/cyberdeb/zephyrproject/zephyr/soc/snps/nsim/arc_classic/Kconfig"
osource "/home/cyberdeb/zephyrproject/zephyr/soc/snps/hsdk4xd/Kconfig"
osource "/home/cyberdeb/zephyrproject/zephyr/soc/snps/hsdk/Kconfig"
osource "/home/cyberdeb/zephyrproject/zephyr/soc/snps/emsk/Kconfig"
osource "/home/cyberdeb/zephyrproject/zephyr/soc/snps/emsdp/Kconfig"
osource "/home/cyberdeb/zephyrproject/zephyr/soc/snps/arc_iot/Kconfig"
osource "/home/cyberdeb/zephyrproject/zephyr/soc/silabs/Kconfig"
osource "/home/cyberdeb/zephyrproject/zephyr/soc/sifli/sf32/Kconfig"
osource "/home/cyberdeb/zephyrproject/zephyr/soc/sifive/sifive_freedom/Kconfig"
osource "/home/cyberdeb/zephyrproject/zephyr/soc/sensry/Kconfig"
osource "/home/cyberdeb/zephyrproject/zephyr/soc/rockchip/Kconfig"
osource "/home/cyberdeb/zephyrproject/zephyr/soc/renode/riscv_virtual/Kconfig"
osource "/home/cyberdeb/zephyrproject/zephyr/soc/renode/cortex_r8_virtual/Kconfig"
osource "/home/cyberdeb/zephyrproject/zephyr/soc/renesas/smartbond/Kconfig"
osource "/home/cyberdeb/zephyrproject/zephyr/soc/renesas/rz/Kconfig"
osource "/home/cyberdeb/zephyrproject/zephyr/soc/renesas/rx/Kconfig"
osource "/home/cyberdeb/zephyrproject/zephyr/soc/renesas/rcar/Kconfig"
osource "/home/cyberdeb/zephyrproject/zephyr/soc/renesas/ra/Kconfig"
osource "/home/cyberdeb/zephyrproject/zephyr/soc/realtek/ec/Kconfig"
osource "/home/cyberdeb/zephyrproject/zephyr/soc/raspberrypi/rpi_pico/Kconfig"
osource "/home/cyberdeb/zephyrproject/zephyr/soc/quicklogic/eos_s3/Kconfig"
osource "/home/cyberdeb/zephyrproject/zephyr/soc/qemu/virt_riscv/Kconfig"
osource "/home/cyberdeb/zephyrproject/zephyr/soc/qemu/malta/Kconfig"
osource "/home/cyberdeb/zephyrproject/zephyr/soc/openisa/rv32m1/Kconfig"
osource "/home/cyberdeb/zephyrproject/zephyr/soc/openhwgroup/cva6/Kconfig"
osource "/home/cyberdeb/zephyrproject/zephyr/soc/oct/osd32mp15x/Kconfig"
osource "/home/cyberdeb/zephyrproject/zephyr/soc/nxp/s32/Kconfig"
osource "/home/cyberdeb/zephyrproject/zephyr/soc/nxp/rw/Kconfig"
osource "/home/cyberdeb/zephyrproject/zephyr/soc/nxp/mcx/Kconfig"
osource "/home/cyberdeb/zephyrproject/zephyr/soc/nxp/lpc/Kconfig"
osource "/home/cyberdeb/zephyrproject/zephyr/soc/nxp/layerscape/Kconfig"
osource "/home/cyberdeb/zephyrproject/zephyr/soc/nxp/kinetis/Kconfig"
osource "/home/cyberdeb/zephyrproject/zephyr/soc/nxp/imxrt/Kconfig"
osource "/home/cyberdeb/zephyrproject/zephyr/soc/nxp/imx/Kconfig"
osource "/home/cyberdeb/zephyrproject/zephyr/soc/nuvoton/numicro/Kconfig"
osource "/home/cyberdeb/zephyrproject/zephyr/soc/nuvoton/numaker/Kconfig"
osource "/home/cyberdeb/zephyrproject/zephyr/soc/nuvoton/npcx/Kconfig"
osource "/home/cyberdeb/zephyrproject/zephyr/soc/nuvoton/npcm/Kconfig"
osource "/home/cyberdeb/zephyrproject/zephyr/soc/nordic/Kconfig"
osource "/home/cyberdeb/zephyrproject/zephyr/soc/neorv32/Kconfig"
osource "/home/cyberdeb/zephyrproject/zephyr/soc/native/inf_clock/Kconfig"
osource "/home/cyberdeb/zephyrproject/zephyr/soc/microchip/sam/Kconfig"
osource "/home/cyberdeb/zephyrproject/zephyr/soc/microchip/sam/sama7/Kconfig"
osource "/home/cyberdeb/zephyrproject/zephyr/soc/microchip/sam/sam_d5x_e5x/Kconfig"
osource "/home/cyberdeb/zephyrproject/zephyr/soc/microchip/pic32c/pic32cz_ca/Kconfig"
osource "/home/cyberdeb/zephyrproject/zephyr/soc/microchip/pic32c/pic32cx_sg/Kconfig"
osource "/home/cyberdeb/zephyrproject/zephyr/soc/microchip/pic32c/pic32cm_jh/Kconfig"
osource "/home/cyberdeb/zephyrproject/zephyr/soc/microchip/miv/Kconfig"
osource "/home/cyberdeb/zephyrproject/zephyr/soc/microchip/mec/Kconfig"
osource "/home/cyberdeb/zephyrproject/zephyr/soc/mediatek/mt8xxx/Kconfig"
osource "/home/cyberdeb/zephyrproject/zephyr/soc/lowrisc/opentitan/Kconfig"
osource "/home/cyberdeb/zephyrproject/zephyr/soc/litex/litex_vexriscv/Kconfig"
osource "/home/cyberdeb/zephyrproject/zephyr/soc/ite/ec/Kconfig"
osource "/home/cyberdeb/zephyrproject/zephyr/soc/intel/raptor_lake/Kconfig"
osource "/home/cyberdeb/zephyrproject/zephyr/soc/intel/panther_lake/Kconfig"
osource "/home/cyberdeb/zephyrproject/zephyr/soc/intel/lakemont/Kconfig"
osource "/home/cyberdeb/zephyrproject/zephyr/soc/intel/intel_socfpga_std/Kconfig"
osource "/home/cyberdeb/zephyrproject/zephyr/soc/intel/intel_socfpga/Kconfig"
osource "/home/cyberdeb/zephyrproject/zephyr/soc/intel/intel_niosv/Kconfig"
osource "/home/cyberdeb/zephyrproject/zephyr/soc/intel/intel_ish/Kconfig"
osource "/home/cyberdeb/zephyrproject/zephyr/soc/intel/intel_adsp/Kconfig"
osource "/home/cyberdeb/zephyrproject/zephyr/soc/intel/elkhart_lake/Kconfig"
osource "/home/cyberdeb/zephyrproject/zephyr/soc/intel/atom/Kconfig"
osource "/home/cyberdeb/zephyrproject/zephyr/soc/intel/apollo_lake/Kconfig"
osource "/home/cyberdeb/zephyrproject/zephyr/soc/intel/alder_lake/Kconfig"
osource "/home/cyberdeb/zephyrproject/zephyr/soc/infineon/edge/Kconfig"
osource "/home/cyberdeb/zephyrproject/zephyr/soc/infineon/cat3/Kconfig"
osource "/home/cyberdeb/zephyrproject/zephyr/soc/infineon/cat1c/Kconfig"
osource "/home/cyberdeb/zephyrproject/zephyr/soc/infineon/cat1b/Kconfig"
osource "/home/cyberdeb/zephyrproject/zephyr/soc/infineon/cat1a/Kconfig"
osource "/home/cyberdeb/zephyrproject/zephyr/soc/gd/gd32/Kconfig"
osource "/home/cyberdeb/zephyrproject/zephyr/soc/gaisler/leon3/Kconfig"
osource "/home/cyberdeb/zephyrproject/zephyr/soc/gaisler/gr716a/Kconfig"
osource "/home/cyberdeb/zephyrproject/zephyr/soc/espressif/Kconfig"
osource "/home/cyberdeb/zephyrproject/zephyr/soc/ene/kb1200/Kconfig"
osource "/home/cyberdeb/zephyrproject/zephyr/soc/ene/kb106x/Kconfig"
osource "/home/cyberdeb/zephyrproject/zephyr/soc/egis/Kconfig"
osource "/home/cyberdeb/zephyrproject/zephyr/soc/efinix/sapphire/Kconfig"
osource "/home/cyberdeb/zephyrproject/zephyr/soc/cdns/xtensa_sample_controller/Kconfig"
osource "/home/cyberdeb/zephyrproject/zephyr/soc/cdns/sample_controller32/Kconfig"
osource "/home/cyberdeb/zephyrproject/zephyr/soc/cdns/dc233c/Kconfig"
osource "/home/cyberdeb/zephyrproject/zephyr/soc/brcm/bcmvk/Kconfig"
osource "/home/cyberdeb/zephyrproject/zephyr/soc/brcm/bcm2712/Kconfig"
osource "/home/cyberdeb/zephyrproject/zephyr/soc/brcm/bcm2711/Kconfig"
osource "/home/cyberdeb/zephyrproject/zephyr/soc/bflb/Kconfig"
osource "/home/cyberdeb/zephyrproject/zephyr/soc/atmel/sam0/Kconfig"
osource "/home/cyberdeb/zephyrproject/zephyr/soc/atmel/sam/Kconfig"
osource "/home/cyberdeb/zephyrproject/zephyr/soc/aspeed/Kconfig"
osource "/home/cyberdeb/zephyrproject/zephyr/soc/arm/Kconfig"
osource "/home/cyberdeb/zephyrproject/zephyr/soc/arm/beetle/Kconfig"
osource "/home/cyberdeb/zephyrproject/zephyr/soc/antmicro/myra/Kconfig"
osource "/home/cyberdeb/zephyrproject/zephyr/soc/andestech/Kconfig"
osource "/home/cyberdeb/zephyrproject/zephyr/soc/amd/acp_6_0/Kconfig"
osource "/home/cyberdeb/zephyrproject/zephyr/soc/ambiq/Kconfig"
osource "/home/cyberdeb/zephyrproject/zephyr/soc/aesc/Kconfig"
osource "/home/cyberdeb/zephyrproject/zephyr/soc/adi/max32/Kconfig"
```
